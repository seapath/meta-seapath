## conf/distro/include/enable-uefi-secureboot.inc
```bitbake
# Copyright (C) 2021, RTE (http://www.rte-france.com)
# SPDX-License-Identifier: Apache-2.0

# Configuration to use meta-secure-core layer signing facilities
# to implement UEFI SecureBoot.

# Set the UEFI SecureBoot feature
DISTRO_FEATURES:append = " efi-secure-boot"

# Controls whether the signing is using samples or real keys
SIGNING_MODEL = "user"

# Directories where Secureboot certs will be stored.
# UEFI_SECUREBOOT_KEYS_DIR is defined in the layer
# configuration.
UEFI_SB_KEYS_DIR = "${UEFI_SECUREBOOT_KEYS_DIR}/uefi-sb-keys"

# Enable UEFI SecureBoot signing
UEFI_SB = "1"

# Do not use MOK protocol as SEAPATH is intended to be installed
# on systems where the installer can overwrite UEFI SecureBoot
# DB/DBX/KEK/PK variables without needing shim.
MOK_SB = "0"

# Use SELoader for GRUB to sign any artifact with SecureBoot keys
# and allow propagation of SecureBoot chain up to the kernel.
UEFI_SELOADER = "1"

# GPG signing will not be used as the GRUB is supposed to
# be a static binary and kernel will be signed and verified
# by SELoader.
GRUB_SIGN_VERIFY = "0"
GRUB_SIGN_VERIFY_STRICT = "0"

# Set signed files into the appropriate boot folder
EFI_BOOT_PATH = "/boot/EFI/BOOT"

# Set correct ESP partition target path for SELoader and
# OVMF DXE drivers
EFI_TARGET:pn-seloader = "${EFI_BOOT_PATH}"
EFI_TARGET:pn-ovmf = "${EFI_BOOT_PATH}"
```

## conf/distro/include/traceability/seapath-guest-efi-image/anssi-nt28-rev12.inc
```bitbake
# Copyright (C) 2021, RTE (http://www.rte-france.com)
# SPDX-License-Identifier: Apache-2.0

TRACEABILITY_ANSSINT28[R1] = "yocto:do_manifests_archiver"
TRACEABILITY_ANSSINT28[R2] = ""
TRACEABILITY_ANSSINT28[R3] = "cukinia:SEAPATH-00085 cukinia:SEAPATH-00086 cukinia:SEAPATH-00104"
TRACEABILITY_ANSSINT28[R4] = "cukinia:SEAPATH-00085 cukinia:SEAPATH-00086"
TRACEABILITY_ANSSINT28[R5] = "cukinia:SEAPATH-00085 cukinia:SEAPATH-00086"
TRACEABILITY_ANSSINT28[R6] = "cukinia:SEAPATH-00085 cukinia:SEAPATH-00086"
TRACEABILITY_ANSSINT28[R7] = "cukinia:SEAPATH-00083 cukinia:SEAPATH-00084"
TRACEABILITY_ANSSINT28[R8] = ""
TRACEABILITY_ANSSINT28[R9] = ""
TRACEABILITY_ANSSINT28[R10] = ""
TRACEABILITY_ANSSINT28[R11] = ""
TRACEABILITY_ANSSINT28[R12] = "cukinia:SEAPATH-00082"
TRACEABILITY_ANSSINT28[R13] = ""
TRACEABILITY_ANSSINT28[R14] = "yocto:do_manifests_archiver"
TRACEABILITY_ANSSINT28[R15] = "yocto:do_manifests_archiver"
TRACEABILITY_ANSSINT28[R16] = "yocto:do_manifests_archiver"
TRACEABILITY_ANSSINT28[R17] = "yocto:grub_file_is_setup_properly"
TRACEABILITY_ANSSINT28[R18] = "cukinia:SEAPATH-00088 cukinia:SEAPATH-00089 cukinia:SEAPATH-00091"
TRACEABILITY_ANSSINT28[R19] = "cukinia:SEAPATH-00103"
TRACEABILITY_ANSSINT28[R20] = ""
TRACEABILITY_ANSSINT28[R21] = "cukinia:SEAPATH-00085 cukinia:SEAPATH-00086"
TRACEABILITY_ANSSINT28[R22] = "cukinia:SEAPATH-00109"
TRACEABILITY_ANSSINT28[R23] = "cukinia:SEAPATH-00109"
TRACEABILITY_ANSSINT28[R24] = "cukinia:SEAPATH-00109"
TRACEABILITY_ANSSINT28[R25] = "cukinia:SEAPATH-00109"
TRACEABILITY_ANSSINT28[R26] = ""
TRACEABILITY_ANSSINT28[R27] = ""
TRACEABILITY_ANSSINT28[R28] = ""
TRACEABILITY_ANSSINT28[R29] = "cukinia:SEAPATH-00092 cukinia:SEAPATH-00094"
TRACEABILITY_ANSSINT28[R30] = "cukinia:SEAPATH-00098 cukinia:SEAPATH-00101 cukinia:SEAPATH-00099 cukinia:SEAPATH-00100"
TRACEABILITY_ANSSINT28[R31] = ""
TRACEABILITY_ANSSINT28[R32] = "cukinia:SEAPATH-00091 cukinia:SEAPATH-00095 cukinia:SEAPATH-00096 cukinia:SEAPATH-00097"
TRACEABILITY_ANSSINT28[R33] = ""
TRACEABILITY_ANSSINT28[R34] = ""
TRACEABILITY_ANSSINT28[R35] = ""
TRACEABILITY_ANSSINT28[R36] = "cukinia:SEAPATH-00001 cukinia:SEAPATH-00002 cukinia:SEAPATH-00049 cukinia:SEAPATH-00090 cukinia:SEAPATH-00106 cukinia:SEAPATH-00107 cukinia:SEAPATH-00108"
TRACEABILITY_ANSSINT28[R37] = ""
TRACEABILITY_ANSSINT28[R38] = "cukinia:SEAPATH-00105"
TRACEABILITY_ANSSINT28[R39] = "cukinia:SEAPATH-00085 cukinia:SEAPATH-00086"
TRACEABILITY_ANSSINT28[R40] = ""
TRACEABILITY_ANSSINT28[R41] = ""
TRACEABILITY_ANSSINT28[R42] = "yocto:do_manifests_archiver cukinia:SEAPATH-00083"
TRACEABILITY_ANSSINT28[R43] = "cukinia:SEAPATH-00085 cukinia:SEAPATH-00086"
TRACEABILITY_ANSSINT28[R44] = ""
TRACEABILITY_ANSSINT28[R45] = ""
TRACEABILITY_ANSSINT28[R46] = ""
TRACEABILITY_ANSSINT28[R47] = "cukinia:SEAPATH-00082"
TRACEABILITY_ANSSINT28[R48] = ""
TRACEABILITY_ANSSINT28[R49] = ""
TRACEABILITY_ANSSINT28[R50] = ""
TRACEABILITY_ANSSINT28[R51] = ""
TRACEABILITY_ANSSINT28[R52] = ""
TRACEABILITY_ANSSINT28[R53] = "cukinia:SEAPATH-00085 cukinia:SEAPATH-00086"
TRACEABILITY_ANSSINT28[R54] = ""
TRACEABILITY_ANSSINT28[R55] = "cukinia:SEAPATH-00085 cukinia:SEAPATH-00086"
TRACEABILITY_ANSSINT28[R56] = "cukinia:SEAPATH-00085 cukinia:SEAPATH-00086"
TRACEABILITY_ANSSINT28[R57] = "cukinia:SEAPATH-00104"
TRACEABILITY_ANSSINT28[R58] = ""
TRACEABILITY_ANSSINT28[R59] = ""
```

## conf/distro/include/traceability/seapath-host-efi-image/anssi-nt28-rev12.inc
```bitbake
# Copyright (C) 2021, RTE (http://www.rte-france.com)
# Copyright (C) 2023 Savoir-faire Linux, Inc.
# SPDX-License-Identifier: Apache-2.0

TRACEABILITY_ANSSINT28[R1] = "yocto:do_manifests_archiver"
TRACEABILITY_ANSSINT28[R2] = ""
TRACEABILITY_ANSSINT28[R3] = "cukinia:SEAPATH-00004 cukinia:SEAPATH-00005 cukinia:SEAPATH-00039 cukinia:SEAPATH-00042 cukinia:SEAPATH-00043 cukinia:SEAPATH-00085 cukinia:SEAPATH-00086 cukinia:SEAPATH-00104 cukinia:SEAPATH-00120 cukinia:SEAPATH-00121 cukinia:SEAPATH-00123 cukinia:SEAPATH-00124"
TRACEABILITY_ANSSINT28[R4] = "cukinia:SEAPATH-00005 cukinia:SEAPATH-00084 cukinia:SEAPATH-00085 cukinia:SEAPATH-00086 cukinia:SEAPATH-00120 cukinia:SEAPATH-00121 cukinia:SEAPATH-00123 cukinia:SEAPATH-00124 cukinia:SEAPATH-00125 cukinia:SEAPATH-00126 cukinia:SEAPATH-00127 cukinia:SEAPATH-00128 cukinia:SEAPATH-00129 cukinia:SEAPATH-00130 cukinia:SEAPATH-00131 cukinia:SEAPATH-00132 cukinia:SEAPATH-00133 cukinia:SEAPATH-00134 cukinia:SEAPATH-00135 cukinia:SEAPATH-00136 cukinia:SEAPATH-00137 cukinia:SEAPATH-00138 cukinia:SEAPATH-00139"
TRACEABILITY_ANSSINT28[R5] = "cukinia:SEAPATH-00008 cukinia:SEAPATH-00009 cukinia:SEAPATH-00010 cukinia:SEAPATH-00039 cukinia:SEAPATH-00040 cukinia:SEAPATH-00041 cukinia:SEAPATH-00119 cukinia:SEAPATH-00120 cukinia:SEAPATH-00050"
TRACEABILITY_ANSSINT28[R6] = "cukinia:SEAPATH-00039 cukinia:SEAPATH-00040 cukinia:SEAPATH-00041 cukinia:SEAPATH-00042 cukinia:SEAPATH-00043 cukinia:SEAPATH-00085 cukinia:SEAPATH-00086"
TRACEABILITY_ANSSINT28[R7] = "cukinia:SEAPATH-00083 cukinia:SEAPATH-00084"
TRACEABILITY_ANSSINT28[R8] = ""
TRACEABILITY_ANSSINT28[R9] = "cukinia:SEAPATH-00007 cukinia:SEAPATH-00017 cukinia:SEAPATH-00028 cukinia:SEAPATH-00030 cukinia:SEAPATH-00031 cukinia:SEAPATH-00032 cukinia:SEAPATH-00015 cukinia:SEAPATH-00050"
TRACEABILITY_ANSSINT28[R10] = ""
TRACEABILITY_ANSSINT28[R11] = "cukinia:SEAPATH-00030 cukinia:SEAPATH-00031 cukinia:SEAPATH-00032 cukinia:SEAPATH-00050"
TRACEABILITY_ANSSINT28[R12] = "cukinia:SEAPATH-00082 cukinia:SEAPATH-00140 cukinia:SEAPATH-00141"
TRACEABILITY_ANSSINT28[R13] = ""
TRACEABILITY_ANSSINT28[R14] = "yocto:do_manifests_archiver"
TRACEABILITY_ANSSINT28[R15] = "yocto:do_manifests_archiver"
TRACEABILITY_ANSSINT28[R16] = "yocto:do_manifests_archiver"
TRACEABILITY_ANSSINT28[R17] = "yocto:grub_file_is_setup_properly"
TRACEABILITY_ANSSINT28[R18] = "cukinia:SEAPATH-00088 cukinia:SEAPATH-00089 cukinia:SEAPATH-00091"
TRACEABILITY_ANSSINT28[R19] = "cukinia:SEAPATH-00103"
TRACEABILITY_ANSSINT28[R20] = ""
TRACEABILITY_ANSSINT28[R21] = "cukinia:SEAPATH-00004 cukinia:SEAPATH-00005 cukinia:SEAPATH-00023 cukinia:SEAPATH-00085 cukinia:SEAPATH-00086 cukinia:SEAPATH-00120 cukinia:SEAPATH-00121 cukinia:SEAPATH-00123 cukinia:SEAPATH-00124"
TRACEABILITY_ANSSINT28[R22] = "cukinia:SEAPATH-00109"
TRACEABILITY_ANSSINT28[R23] = "cukinia:SEAPATH-00109"
TRACEABILITY_ANSSINT28[R24] = "cukinia:SEAPATH-00109"
TRACEABILITY_ANSSINT28[R25] = "cukinia:SEAPATH-00109"
TRACEABILITY_ANSSINT28[R26] = "cukinia:SEAPATH-00033 cukinia:SEAPATH-00034 cukinia:SEAPATH-00046 cukinia:SEAPATH-00047 cukinia:SEAPATH-00048"
TRACEABILITY_ANSSINT28[R27] = "cukinia:SEAPATH-00033 cukinia:SEAPATH-00034 cukinia:SEAPATH-00046 cukinia:SEAPATH-00047 cukinia:SEAPATH-00048"
TRACEABILITY_ANSSINT28[R28] = "cukinia:SEAPATH-00033 cukinia:SEAPATH-00034 cukinia:SEAPATH-00046 cukinia:SEAPATH-00047 cukinia:SEAPATH-00048 cukinia:SEAPATH-00039"
TRACEABILITY_ANSSINT28[R29] = "cukinia:SEAPATH-00092 cukinia:SEAPATH-00094"
TRACEABILITY_ANSSINT28[R30] = "cukinia:SEAPATH-00098 cukinia:SEAPATH-00101 cukinia:SEAPATH-00099 cukinia:SEAPATH-00100"
TRACEABILITY_ANSSINT28[R31] = ""
TRACEABILITY_ANSSINT28[R32] = "cukinia:SEAPATH-00091 cukinia:SEAPATH-00095 cukinia:SEAPATH-00096 cukinia:SEAPATH-00097"
TRACEABILITY_ANSSINT28[R33] = ""
TRACEABILITY_ANSSINT28[R34] = ""
TRACEABILITY_ANSSINT28[R35] = "cukinia:SEAPATH-00146"
TRACEABILITY_ANSSINT28[R36] = "cukinia:SEAPATH-00044 cukinia:SEAPATH-00045 cukinia:SEAPATH-00049 cukinia:SEAPATH-00090 cukinia:SEAPATH-00106 cukinia:SEAPATH-00107 cukinia:SEAPATH-00108 cukinia:SEAPATH-00156"
TRACEABILITY_ANSSINT28[R37] = ""
TRACEABILITY_ANSSINT28[R38] = "cukinia:SEAPATH-00105"
TRACEABILITY_ANSSINT28[R39] = ""
TRACEABILITY_ANSSINT28[R40] = ""
TRACEABILITY_ANSSINT28[R41] = "cukinia:SEAPATH-00040 cukinia:SEAPATH-00041"
TRACEABILITY_ANSSINT28[R42] = "cukinia:SEAPATH-00003 cukinia:SEAPATH-00020 cukinia:SEAPATH-00035 cukinia:SEAPATH-00083 cukinia:SEAPATH-00119 cukinia:SEAPATH-00122 cukinia:SEAPATH-00125 cukinia:SEAPATH-00126 cukinia:SEAPATH-00127 cukinia:SEAPATH-00128 cukinia:SEAPATH-00129 cukinia:SEAPATH-00130 cukinia:SEAPATH-00131 cukinia:SEAPATH-00132 cukinia:SEAPATH-00133 cukinia:SEAPATH-00134 cukinia:SEAPATH-00135 cukinia:SEAPATH-00136 cukinia:SEAPATH-00137 cukinia:SEAPATH-00138 cukinia:SEAPATH-00139"
TRACEABILITY_ANSSINT28[R43] = "cukinia:SEAPATH-00085 cukinia:SEAPATH-00086"
TRACEABILITY_ANSSINT28[R44] = ""
TRACEABILITY_ANSSINT28[R45] = ""
TRACEABILITY_ANSSINT28[R46] = ""
TRACEABILITY_ANSSINT28[R47] = "cukinia:SEAPATH-00082"
TRACEABILITY_ANSSINT28[R48] = ""
TRACEABILITY_ANSSINT28[R49] = ""
TRACEABILITY_ANSSINT28[R50] = "cukinia:SEAPATH-00006 cukinia:SEAPATH-00027"
TRACEABILITY_ANSSINT28[R51] = ""
TRACEABILITY_ANSSINT28[R52] = ""
TRACEABILITY_ANSSINT28[R53] = "cukinia:SEAPATH-00004 cukinia:SEAPATH-00005 cukinia:SEAPATH-00085 cukinia:SEAPATH-00086 cukinia:SEAPATH-00120 cukinia:SEAPATH-00121 cukinia:SEAPATH-00123 cukinia:SEAPATH-00124"
TRACEABILITY_ANSSINT28[R54] = ""
TRACEABILITY_ANSSINT28[R55] = ""
TRACEABILITY_ANSSINT28[R56] = ""
TRACEABILITY_ANSSINT28[R57] = "cukinia:SEAPATH-00104"
TRACEABILITY_ANSSINT28[R58] = "cukinia:SEAPATH-00143 cukinia:SEAPATH-00144 cukinia:SEAPATH-00145 cukinia:SEAPATH-00146 cukinia:SEAPATH-00147 cukinia:SEAPATH-00148 cukinia:SEAPATH-00149"
TRACEABILITY_ANSSINT28[R59] = "cukinia:SEAPATH-00150"
TRACEABILITY_ANSSINT28[R60] = "cukinia:SEAPATH-00151"
TRACEABILITY_ANSSINT28[R61] = "cukinia:SEAPATH-00152"
TRACEABILITY_ANSSINT28[R62] = "cukinia:SEAPATH-00153"
TRACEABILITY_ANSSINT28[R63] = "cukinia:SEAPATH-00154 cukinia:SEAPATH-00155"
TRACEABILITY_ANSSINT28[R64] = "cukinia:SEAPATH-00156"
```

## conf/distro/seapath-containers-host.conf
```bitbake
# Copyright (C) 2024 Savoir-faire Linux, Inc.
# SPDX-License-Identifier: Apache-2.0

DISTROOVERRIDES =. "seapath-sec:"

require conf/distro/seapath-host-common.inc

# Distro description
DISTRO = "seapath-containers-host"
DISTRO_NAME = "Seapath containers host Yocto distribution"
DISTRO_VERSION = "1.0.0"

DISTRO_FEATURES:remove = "kvm"
```

## conf/distro/seapath-flash.conf
```bitbake
# Copyright (C) 2021, RTE (http://www.rte-france.com)
# SPDX-License-Identifier: Apache-2.0

# Distro based on poky
require conf/distro/poky.conf

# Maintainer email
MAINTAINER = "support@savoirfairelinux.com"

# Distro description
DISTRO = "seapath-flash"
DISTRO_NAME = "Seapath Flash Yocto distribution"
DISTRO_VERSION = "1.0"

# Active buildhistory
INHERIT += "buildhistory"
BUILDHISTORY_COMMIT = "1"

# Enable Ansible SSH key copy
DISTRO_FEATURES:append = " ansible"

COMPATIBLE_MACHINE:pn-dpdk = "seapath"

DISTRO_FEATURES:append = " systemd usrmerge"
VIRTUAL-RUNTIME_init_manager = "systemd"
VIRTUAL-RUNTIME_initscripts = "systemd-compat-units"
```

## conf/distro/seapath-guest.conf
```bitbake
# Copyright (C) 2022, RTE (http://www.rte-france.com)
# SPDX-License-Identifier: Apache-2.0

DISTROOVERRIDES =. "seapath-sec:"

require conf/distro/seapath-common.inc

# Distro description
DISTRO = "seapath-guest"
DISTRO_NAME = "Seapath guest Yocto distribution"
DISTRO_VERSION = "1.0"

#Remove uneeded features
DISTRO_FEATURES:remove = "seapath-clustering"
DISTRO_FEATURES:remove = "seapath-readonly"
DISTRO_FEATURES:remove = "seapath-overlay"
DISTRO_FEATURES:remove = "kvm"
DISTRO_FEATURES:remove = "virtualization"
```

## conf/distro/seapath-host-cluster-minimal.conf
```bitbake
# Copyright (C) 2022, RTE (http://www.rte-france.com)
# Copyright (C) 2023 Savoir-faire Linux, Inc.
# SPDX-License-Identifier: Apache-2.0

require conf/distro/seapath-host-common.inc

# Distro description
DISTRO = "seapath-host-cluster-minimal"
DISTRO_NAME = "Seapath Host Cluster Minimal Yocto distribution"
DISTRO_VERSION = "1.0"

#Remove uneeded features
DISTRO_FEATURES:remove = "seapath-readonly"
DISTRO_FEATURES:remove = "seapath-security"
```

## conf/distro/seapath-host-common.inc
```bitbake
# Copyright (C) 2023-2024 Savoir-faire Linux, Inc.
# SPDX-License-Identifier: Apache-2.0

DISTROOVERRIDES =. "seapath-host:"

require conf/distro/seapath-common.inc

# Enable dpdk for openvswitch
PACKAGECONFIG:append:pn-openvswitch = " dpdk"
COMPATIBLE_MACHINE:pn-dpdk = "(seapath)"
REQUIRED_VERSION_dpdk = "23.11.%"
```

## conf/distro/seapath-host-minimal.conf
```bitbake
# Copyright (C) 2022, RTE (http://www.rte-france.com)
# Copyright (C) 2023 Savoir-faire Linux, Inc.
# SPDX-License-Identifier: Apache-2.0

require conf/distro/seapath-host-common.inc

# Distro description
DISTRO = "seapath-host-minimal"
DISTRO_NAME = "Seapath Host Minimal Yocto distribution"
DISTRO_VERSION = "1.0"

#Remove uneeded features
DISTRO_FEATURES:remove = "seapath-clustering"
DISTRO_FEATURES:remove = "seapath-readonly"
DISTRO_FEATURES:remove = "seapath-security"

# Remove uneeded package configuration
PACKAGECONFIG:remove:pn-net-snmp = "cluster"
```

## conf/distro/seapath-host-sb.conf
```bitbake
# Copyright (C) 2021, RTE (http://www.rte-france.com)
# SPDX-License-Identifier: Apache-2.0

# Distro based on SEAPATH
require conf/distro/seapath-host.conf

# Enable UEFI Secureboot
require conf/distro/include/enable-uefi-secureboot.inc
```

## conf/distro/seapath-host.conf
```bitbake
# Copyright (C) 2022, RTE (http://www.rte-france.com)
# Copyright (C) 2023 Savoir-faire Linux, Inc.
# SPDX-License-Identifier: Apache-2.0

require conf/distro/seapath-host-common.inc

# Distro description
DISTRO = "seapath-host"
DISTRO_NAME = "Seapath host Yocto distribution"
DISTRO_VERSION = "1.0"
```

## conf/distro/seapath-observer.conf
```bitbake
# Copyright (C) 2024 Savoir-faire Linux, Inc.
# SPDX-License-Identifier: Apache-2.0

require conf/distro/seapath-common.inc

DISTRO_FEATURES:remove = "kvm"
DISTRO_FEATURES:remove = "virtualization"

# Distro description
DISTRO = "seapath-observer"
DISTRO_NAME = "Seapath Observer Yocto distribution"
DISTRO_VERSION = "1.0"
```

## conf/distro/seapath-ro.conf
```bitbake
# Copyright (C) 2021, RTE (http://www.rte-france.com)
# SPDX-License-Identifier: Apache-2.0

# Distro based on SEAPATH
require conf/distro/seapath.conf

# Enable readonly
DISTRO_FEATURES_append = " seapath-readonly"
DISTRO = "seapath-ro"
INHERIT += "security/readonly"
```

## conf/distro/seapath-standalone-containers-host.conf
```bitbake
# Copyright (C) 2024 Savoir-faire Linux, Inc.
# SPDX-License-Identifier: Apache-2.0

require conf/distro/seapath-containers-host.conf

# Distro description
DISTRO = "seapath-standalone-containers-host"
DISTRO_NAME = "Seapath standalone containers host Yocto distribution"
DISTRO_VERSION = "1.0.0"

DISTRO_FEATURES:remove = "seapath-clustering"
```
