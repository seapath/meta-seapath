## conf/distro/seapath-standalone-host.conf
```bitbake
# Copyright (C) 2024 Savoir-faire Linux, Inc.
# SPDX-License-Identifier: Apache-2.0

DISTROOVERRIDES =. "seapath-sec:"

require conf/distro/seapath-host-common.inc

# Distro description
DISTRO = "seapath-standalone-host"
DISTRO_NAME = "Seapath host Yocto distribution standalone"
DISTRO_VERSION = "1.0.0"

DISTRO_FEATURES:remove = "seapath-clustering"
```

## conf/distro/votp-flash.conf
```bitbake
# Copyright (C) 2021, RTE (http://www.rte-france.com)
# SPDX-License-Identifier: Apache-2.0

# Distro based on poky
require conf/distro/poky.conf

# Maintainer email
MAINTAINER = "support@savoirfairelinux.com"

# Distro description
DISTRO = "votp-flash"
DISTRO_NAME = "Seapath Flash Yocto distribution"
DISTRO_VERSION = "1.0"

# Active buildhistory
INHERIT += "buildhistory"
BUILDHISTORY_COMMIT = "1"

COMPATIBLE_MACHINE_pn-dpdk = "votp"
```

## conf/distro/votp.conf
```bitbake
# Copyright (C) 2020, RTE (http://www.rte-france.com)
# SPDX-License-Identifier: Apache-2.0

# Distro based on poky
require conf/distro/poky.conf

# Maintainer email
MAINTAINER = "support@savoirfairelinux.com"

# Distro description
DISTRO = "votp"
DISTRO_NAME = "Seapath Yocto distribution"
DISTRO_VERSION = "1.0"

# Use systemd as default
DISTRO_FEATURES_append = " systemd"
VIRTUAL-RUNTIME_init_manager = "systemd"
VIRTUAL-RUNTIME_initscripts = "systemd-compat-units"

# Use sysvinit for rescue system
DISTRO_FEATURES_BACKFILL_CONSIDERED += "sysvinit"

# No need for x11 and wayland
DISTRO_FEATURES_remove = " x11"
DISTRO_FEATURES_remove = " wayland"

# Active buildhistory
INHERIT += "buildhistory"
BUILDHISTORY_COMMIT = "1"

# Use virtualization features
DISTRO_FEATURES_append = " virtualization"
DISTRO_FEATURES_append = " kvm"

# Enable dpdk for openvswitch
PACKAGECONFIG_append_pn-openvswitch = " dpdk"
COMPATIBLE_MACHINE_pn-dpdk = "(votp|votp-nuc)"
EXTRA_OECONF_append_pn-openvswitch += "--with-linux=${STAGING_KERNEL_BUILDDIR} --with-linux-source=${STAGING_KERNEL_DIR} KARCH=${TARGET_ARCH}"
PREFERRED_VERSION_openvswitch = "2.13+AUTOINC+71d553b995"
PREFERRED_VERSION_dpdk = "19.11.4"

# Enable ptest
DISTRO_FEATURES_append = " ptest"

# Enable pam
DISTRO_FEATURES_append = " pam"

# Enable security hardening
INHERIT += "security/hardening"
```

## conf/machine/seapath-installer.conf
```bitbake
# Copyright (C) 2022, RTE (http://www.rte-france.com)
# SPDX-License-Identifier: Apache-2.0

#@TYPE: Machine
#@NAME: seapath-installer
#@SOC: x86-64
#@DESCRIPTION: Machine configuration for flash images

require conf/machine/intel-corei7-64.conf
PREFERRED_PROVIDER_virtual/kernel = "linux-mainline-rt"
PREFERRED_VERSION_linux-mainline-rt ?= "6.1.%"
IMAGE_FSTYPES = "wic"
SERIAL_CONSOLES = "115200;ttyS0"
EFI_PROVIDER = "grub-efi"
```

## conf/machine/seapath-machine-common.inc
```bitbake
# Copyright (C) 2022, RTE (http://www.rte-france.com)
# Copyright (C) 2023 Savoir-faire Linux, Inc.
# SPDX-License-Identifier: Apache-2.0

MACHINEOVERRIDES =. "seapath:"

require conf/machine/intel-corei7-64.conf
PREFERRED_PROVIDER_virtual/kernel = "linux-mainline-rt"
PREFERRED_VERSION_linux-mainline-rt ?= "6.1.%"
IMAGE_FSTYPES = "wic"
SERIAL_CONSOLES = "115200;ttyS0"
EFI_PROVIDER = "grub-efi"

# Kernel parameters
APPEND += " \
    audit=0 \
    slab_nomerge \
    slub_debug=ZF \
    rootfstype=ext4 \
    page_poison=on \
    spec_store_bypass_disable=auto \
    mds=full,nosmt \
    mce=0 \
    page_alloc.shuffle=1 \
    rng_core.default_quality=500 \
"
```

## conf/machine/seapath-observer-rpi.conf
```bitbake
# Copyright (C) 2024 Savoir-faire Linux, Inc.
# SPDX-License-Identifier: Apache-2.0

#@TYPE: Machine
#@NAME: seapath-observer-raspberrypi
#@SOC: ARMv8 64bit
#@DESCRIPTION: Machine configuration for monitor machines compatible with SEAPATH

MACHINEOVERRIDES =. "seapath:"

require conf/machine/raspberrypi4-64.conf

APPEND += "init=/sbin/init.sh"

# Use UART console
# TODO: disable it for production
ENABLE_UART = "1"
```

## conf/machine/seapath-observer.conf
```bitbake
# Copyright (C) 2022, RTE (http://www.rte-france.com)
# SPDX-License-Identifier: Apache-2.0

#@TYPE: Machine
#@NAME: seapath-observer
#@SOC: x86-64
#@DESCRIPTION: Machine configuration for observer machines compatible with SEAPATH

require conf/machine/seapath-machine-common.inc
APPEND += "init=/sbin/init.sh"
```

## conf/machine/seapath-vm.conf
```bitbake
# Copyright (C) 2022, RTE (http://www.rte-france.com)
# SPDX-License-Identifier: Apache-2.0

#@TYPE: Machine
#@NAME: seapath-vm
#@SOC: x86-64
#@DESCRIPTION: Machine configuration for virtual machines compatible with SEAPATH

require conf/machine/seapath-machine-common.inc
MACHINE_FEATURES:append = "seapath-guest"
```

## conf/machine/votp-guest.conf
```bitbake
# Copyright (C) 2022, RTE (http://www.rte-france.com)
# SPDX-License-Identifier: Apache-2.0

#@TYPE: Machine
#@NAME: votp-guest
#@SOC: x86-64
#@DESCRIPTION: Machine configuration for virtual machines compatible with SEAPATH

require conf/machine/votp-machine-common.inc
MACHINE_FEATURES:append = "seapath-guest"
```

## conf/machine/votp-host.conf
```bitbake
# Copyright (C) 2022, RTE (http://www.rte-france.com)
# SPDX-License-Identifier: Apache-2.0

#@TYPE: Machine
#@NAME: votp-host
#@SOC: x86-64
#@DESCRIPTION: Machine configuration for hypervisor compatible with SEAPATH

require conf/machine/votp-machine-common.inc
APPEND += " \
    init=/sbin/init.sh \
    default_hugepagesz=1G \
    hugepagesz=1G \
    skew_tick=1 \
    rcutree.kthread_prio=10 \
    kvm.halt_poll_ns=0 \
    "
```

## conf/machine/votp-machine-common.inc
```bitbake
# Copyright (C) 2022, RTE (http://www.rte-france.com)
# SPDX-License-Identifier: Apache-2.0

require conf/machine/intel-corei7-64.conf
PREFERRED_PROVIDER_virtual/kernel = "linux-mainline-rt"
PREFERRED_VERSION_linux-mainline-rt ?= "5.15.%"
IMAGE_FSTYPES = "wic"
SERIAL_CONSOLES = "115200;ttyS0"
EFI_PROVIDER = "grub-efi"

MACHINEOVERRIDES =. "votp:"
# Kernel parameters
APPEND += " \
    systemd.unified_cgroup_hierarchy=0 \
    audit=0 \
    slab_nomerge \
    slub_debug=ZF \
    rootwait \
    rootfstype=ext4 \
"
```
