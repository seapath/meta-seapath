## conf/machine/include/seapath-hypervisor-aaeon.inc
```bitbake
# Copyright (C) 2024-2025 Savoir-faire Linux, Inc.
# SPDX-License-Identifier: Apache-2.0

MACHINEOVERRIDES =. "seapath:seapath-hypervisor-aaeon:"

require conf/machine/include/seapath-hypervisor-common.inc

PREFERRED_PROVIDER_virtual/bootloader:imx-nxp-bsp = "u-boot-imx"
PREFERRED_PROVIDER_virtual/kernel:imx-nxp-bsp = "linux-imx"

# Use the meta-imx dpdk recipe
REQUIRED_VERSION_dpdk:seapath-hypervisor-aaeon = "21.11"

# Kernel parameters
APPEND += " \
    ro \
"
```

## conf/machine/include/seapath-hypervisor-common.inc
```bitbake
# Copyright (C) 2022, RTE (http://www.rte-france.com)
# Copyright (C) 2024 Savoir-faire Linux, Inc.
# SPDX-License-Identifier: Apache-2.0

require conf/machine/include/seapath-machine-common.inc

APPEND += " \
    ${@bb.utils.contains('DISTRO_FEATURES', 'seapath-overlay', 'init=/sbin/init.sh', '', d)} \
    default_hugepagesz=1G \
    hugepagesz=1G \
    skew_tick=1 \
    rcutree.kthread_prio=10 \
    ${@bb.utils.contains("DISTRO_FEATURES", "kvm", "kvm.halt_poll_ns=0", "", d)
    "
```

## conf/machine/include/seapath-machine-common.inc
```bitbake
# Copyright (C) 2022, RTE (http://www.rte-france.com)
# Copyright (C) 2023-2024 Savoir-faire Linux, Inc.
# SPDX-License-Identifier: Apache-2.0

MACHINEOVERRIDES =. "seapath:"

IMAGE_FSTYPES = "wic"
SERIAL_CONSOLES = "115200;ttyS0"

# Kernel parameters
APPEND += " \
    systemd.unified_cgroup_hierarchy=0 \
    audit=0 \
    slab_nomerge \
    slub_debug=ZF \
    rootfstype=ext4 \
"
```

## conf/machine/seapath-hypervisor-aaeon.conf
```bitbake
# Copyright (C) 2024 Savoir-faire Linux, Inc.
# SPDX-License-Identifier: Apache-2.0

#@TYPE: Machine
#@NAME: seapath-hypervisor-aaeon
#@SOC: ARM i.MX8M
#@DESCRIPTION: Machine configuration for host machines compatible with SEAPATH

MACHINEOVERRIDES =. "seapath:"

require conf/machine/srg-imx8p-2g.conf
require conf/machine/include/seapath-hypervisor-common.inc

PREFERRED_PROVIDER_virtual/bootloader:imx-nxp-bsp = "u-boot-imx"
PREFERRED_PROVIDER_virtual/kernel:imx-nxp-bsp = "linux-imx"

# Use the meta-imx dpdk recipe
REQUIRED_VERSION_dpdk:seapath-hypervisor-aaeon = "21.11"

# Kernel parameters
APPEND += " \
    ro \
"
```
